## Kconfig
```kconfig
DT_COMPAT_ZMK_BEHAVIOR_STATUS_SELECTOR_HANDLER := zmk,behavior-status-selector-handler
DT_COMPAT_ZMK_BEHAVIOR_STATUS_SELECTOR_TOGGLE := zmk,behavior-status-selector-toggle

config ZMK_BEHAVIOR_STATUS_SELECTOR_HANDLER
    bool
    default $(dt_compat_enabled,$(DT_COMPAT_ZMK_BEHAVIOR_STATUS_SELECTOR_HANDLER))

config ZMK_BEHAVIOR_STATUS_SELECTOR_TOGGLE
    bool
    default $(dt_compat_enabled,$(DT_COMPAT_ZMK_BEHAVIOR_STATUS_SELECTOR_TOGGLE))
```

## dts/bindings/behaviors/zmk,behavior-rgb-mode-toggle.yaml
```yaml
description: Toggles an RGB mode behavior state.

compatible: "zmk,behavior-rgb-mode-toggle"

include: zero_param.yaml

properties:
  rgb-mode:
    type: phandle
    required: true
    description: RGB mode behavior node controlled by this toggle.
```

## dts/bindings/behaviors/zmk,behavior-rgb-mode.yaml
```yaml
description: Applies the configured RGB binding for the current RGB mode.

compatible: "zmk,behavior-rgb-mode"

include: zero_param.yaml

properties:
  bindings:
    type: phandle-array
    required: true
    description: Exactly two bindings in the order ON, OFF.
```

## dts/bindings/behaviors/zmk,behavior-status-selector-handler.yaml
```yaml
description: Applies the configured binding for the current selected status.

compatible: "zmk,behavior-status-selector-handler"

include: zero_param.yaml

properties:
  bindings:
    type: phandle-array
    required: true
    description: Exactly two bindings in the order selected, unselected.
```

## dts/bindings/behaviors/zmk,behavior-status-selector-toggle.yaml
```yaml
description: Toggles a status selector state.

compatible: "zmk,behavior-status-selector-toggle"

include: zero_param.yaml

properties:
  handler:
    type: phandle
    required: true
    description: Status selector handler node controlled by this toggle.
```
